## drivers/input/fingerprint/Kconfig
```kconfig
config NUBIA_FINGERPRINT
	tristate "Nubia's goodix under-display fingerprint driver"
	depends on MACH_NUBIA_NX659J
	default y
	help
		Add support for goodix under-display fingerprint driver.
```

## drivers/nubia/fingerprint/Kconfig
```kconfig
################################################## FINGER_PRINTER START

######## Add for goodix fingerprint Start ########
config NUBIA_FP_GOODIX
	tristate "generic goodix fingerprint driver"
	default y
	help
	add support for goodix fingerprint driver.

if NUBIA_FP_GOODIX
source "drivers/nubia/fingerprint/goodix/Kconfig"
endif
######## Add for goodix fingerprint End   ########

################################################## FINGER_PRINTER END
```

## drivers/nubia/fingerprint/goodix/Kconfig
```kconfig
config NUBIA_FP_GOODIX_GW9558
	tristate "generic goodix GW9558 driver"
	default y
	help
	add support for goodix GW9558 driver.
```

## drivers/platform/nubia/Kconfig
```kconfig
# Nubia configuration options

config MACH_NUBIA
	bool "Nubia device"
	depends on ARCH_QCOM
	help
	  Support for Nubia products

config MACH_NUBIA_SM8250
	bool "Nubia SM8250"
	depends on ARCH_QCOM
	select MACH_NUBIA
	help
	  Support for Nubia SM8250 devices

menu "Nubia board selection"
	config MACH_NUBIA_NX659J
		bool "Nubia NX659J board"
		select MACH_NUBIA_SM8250
		help
		  Support for Nubia Red Magic 5G
endmenu
```

## drivers/power/Kconfig
```kconfig
source "drivers/power/avs/Kconfig"
source "drivers/power/reset/Kconfig"
source "drivers/power/supply/Kconfig"

#Begin [ljz add the kernel power code,20200615]
source "drivers/power/ztemt_power_debug/Kconfig"
#End   [ljz add the kernel power code,20200615]
```

## drivers/usb/dp/Kconfig
```kconfig
#
# ZTE SoC drivers
#

config NUBIA_DP
	bool "NUBIA USB DP"
	default y
	help
	  USB switch to Nubia's display port function
```
