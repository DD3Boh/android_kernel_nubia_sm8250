#include "audio.dtsi"
#include "others.dtsi"
#include "display.dtsi"
#include "camera.dtsi"
#include "tp.dtsi"
#include "haptic.dtsi"

#include "sensors.dtsi"
#include "leds.dtsi"
#include "aw22xxx.dtsi"
#include "neo-power.dtsi"
#include "nfc.dtsi"
#include "usb.dtsi"
#include "finger.dtsi"
